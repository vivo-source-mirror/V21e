## drivers/fingerprint/Kconfig
```kconfig
menu "BBK FINGERPRINT support"
config BBK_FINGERPRINT
	tristate "BBK FINGERPRINT support"
	help
	  Say Y here to enable switch class support.

if BBK_FINGERPRINT

config BBK_FP_ID
	tristate "BBK FP ID support"
	help
	  Say Y here to enable switch class support.

config BBK_FP_HBM_INPUT
	tristate "BBK FP HBM INPUT support"
	help
	  Say Y here to enable switch class support.
endif

source "drivers/fingerprint/gf9518/Kconfig"
endmenu
```

## drivers/vledpower/Kconfig
```kconfig
config PROX_VLED_POWER
	bool "proximity vled power Support"
	help
	  This option enables the vled sysfs class in /sys/class/enable.
	  You'll need this to do anything useful with power. If unsure, say N.
```
