/* Copyright (c) 2017-2018, The Linux Foundation. All rights reserved.
 *
 * This program is free software; you can redistribute it and/or modify
 * it under the terms of the GNU General Public License version 2 and
 * only version 2 as published by the Free Software Foundation.
 *
 * This program is distributed in the hope that it will be useful,
 * but WITHOUT ANY WARRANTY; without even the implied warranty of
 * MERCHANTABILITY or FITNESS FOR A PARTICULAR PURPOSE.  See the
 * GNU General Public License for more details.
 */

&mdss_mdp {
	dsi_pd1941_nt36672a_tianma_1080p_video: qcom,mdss_dsi_pd1941_nt36672a_tianma_1080p_video {
		qcom,mdss-dsi-panel-name =
				"dsi pd1941 nt36672a tianma 1080p video mode dsi panel";
		qcom,mdss-dsi-panel-type = "dsi_video_mode";
		qcom,mdss-dsi-virtual-channel-id = <0>;
		qcom,mdss-dsi-stream = <0>;
		qcom,mdss-dsi-bpp = <24>;
		qcom,mdss-pan-physical-width-dimension = <69>;
		qcom,mdss-pan-physical-height-dimension = <151>;
		qcom,mdss-dsi-underflow-color = <0xff>;
		qcom,mdss-dsi-border-color = <0>;
		qcom,mdss-dsi-traffic-mode = "non_burst_sync_event";
		qcom,mdss-dsi-bllp-eof-power-mode;
		qcom,mdss-dsi-bllp-power-mode;
		qcom,mdss-dsi-lane-0-state;
		qcom,mdss-dsi-lane-1-state;
		qcom,mdss-dsi-lane-2-state;
		qcom,mdss-dsi-lane-3-state;
		qcom,mdss-dsi-dma-trigger = "trigger_sw";
		qcom,mdss-dsi-mdp-trigger = "none";
		qcom,mdss-dsi-reset-sequence = <1 10>, <0 5>, <1 10>;
		qcom,mdss-dsi-tx-eot-append;
		qcom,mdss-dsi-post-init-delay = <1>;
		qcom,mdss-dsi-lp11-init;
		/*define vivo private properties*/
		qcom,mdss-dsi-project-name = "pd1941";
		qcom,mdss-dsi-panel-id = <0x11>;
		qcom,vivo-dsi-panel-type = "tft";
		qcom,mdss-panel-sre;
		qcom,mdss-dsi-lcm-sre-max-level = <0xF0>;

		qcom,mdss-dsi-display-timings {
			timing@0{
				qcom,mdss-dsi-panel-width = <1080>;
				qcom,mdss-dsi-panel-height = <2340>;
				qcom,mdss-dsi-h-front-porch = <96>;
				qcom,mdss-dsi-h-back-porch = <127>;
				qcom,mdss-dsi-h-pulse-width = <10>;
				qcom,mdss-dsi-h-sync-skew = <0>;
				qcom,mdss-dsi-v-back-porch = <8>;
				qcom,mdss-dsi-v-front-porch = <22>;
				qcom,mdss-dsi-v-pulse-width = <2>;
				qcom,mdss-dsi-panel-framerate = <60>;
				qcom,mdss-dsi-h-left-border = <0>;
				qcom,mdss-dsi-h-right-border = <0>;
				qcom,mdss-dsi-v-top-border = <0>;
				qcom,mdss-dsi-v-bottom-border = <0>;
				qcom,mdss-dsi-on-command = [
					39 01 00 00 00 00 02 FF 20
					39 01 00 00 00 00 02 FB 01
					39 01 00 00 00 00 11 B0 00 1D 00 35 00 5C 00 7C 00 97 00 AE 00 C3 00 D5
					39 01 00 00 00 00 11 B1 00 E6 01 1E 01 46 01 86 01 B4 01 FD 02 34 02 35
					39 01 00 00 00 00 11 B2 02 6C 02 A9 02 D3 03 03 03 27 03 4E 03 5E 03 6C
					39 01 00 00 00 00 0F B3 03 7E 03 94 03 AF 03 C8 03 D2 03 D4 00 00
					39 01 00 00 00 00 11 B4 00 77 00 86 00 A0 00 B7 00 CB 00 DC 00 ED 00 FB
					39 01 00 00 00 00 11 B5 01 09 01 37 01 5A 01 94 01 BE 02 03 02 39 02 3A
					39 01 00 00 00 00 11 B6 02 70 02 AC 02 D6 03 06 03 2A 03 51 03 61 03 6F
					39 01 00 00 00 00 0F B7 03 80 03 96 03 9F 03 C7 03 D2 03 D4 00 00
					39 01 00 00 00 00 11 B8 00 00 00 28 00 57 00 7B 00 98 00 B1 00 C7 00 DA
					39 01 00 00 00 00 11 B9 00 EB 01 24 01 4C 01 8C 01 B9 02 01 02 38 02 39
					39 01 00 00 00 00 11 BA 02 6F 02 AB 02 D5 03 06 03 2A 03 50 03 60 03 70
					39 01 00 00 00 00 0F BB 03 83 03 9B 03 B6 03 CA 03 D2 03 D4 00 00
					39 01 00 00 00 00 02 FF 21
					39 01 00 00 00 00 02 FB 01
					39 01 00 00 00 00 11 B0 00 15 00 2D 00 54 00 74 00 8F 00 A6 00 BB 00 CD
					39 01 00 00 00 00 11 B1 00 DE 01 16 01 3E 01 7E 01 AC 01 F5 02 2C 02 2D
					39 01 00 00 00 00 11 B2 02 64 02 A1 02 CB 02 FB 03 1F 03 46 03 56 03 64
					39 01 00 00 00 00 0F B3 03 76 03 8C 03 A7 03 C0 03 D2 03 D4 00 00
					39 01 00 00 00 00 11 B4 00 6F 00 7E 00 98 00 AF 00 C3 00 D4 00 E5 00 F3
					39 01 00 00 00 00 11 B5 01 01 01 2F 01 52 01 8C 01 B6 01 FB 02 31 02 32
					39 01 00 00 00 00 11 B6 02 68 02 A4 02 CE 02 FE 03 22 03 49 03 59 03 67
					39 01 00 00 00 00 0F B7 03 78 03 8E 03 97 03 BF 03 D2 03 D4 00 00
					39 01 00 00 00 00 11 B8 00 00 00 20 00 4F 00 73 00 90 00 A9 00 BF 00 D2
					39 01 00 00 00 00 11 B9 00 E3 01 1C 01 44 01 84 01 B1 01 F9 02 30 02 31
					39 01 00 00 00 00 11 BA 02 67 02 A3 02 CD 02 FE 03 22 03 48 03 58 03 68
					39 01 00 00 00 00 0F BB 03 7B 03 93 03 AE 03 C2 03 D2 03 D4 00 00
					39 01 00 00 00 00 02 FF 22
					39 01 00 00 00 00 02 FB 01
					39 01 00 00 00 00 02 54 00
					39 01 00 00 00 00 02 53 00
					39 01 00 00 00 00 02 17 00
					39 01 00 00 00 00 02 B8 00
					39 01 00 00 00 00 02 BC 1F
					39 01 00 00 00 00 02 BD 1F
					39 01 00 00 00 00 02 BE 1F
					39 01 00 00 00 00 02 EC 39
					39 01 00 00 00 00 02 C8 0B
					39 01 00 00 00 00 02 CA 77
					39 01 00 00 00 00 02 FF 10
					39 01 00 00 00 00 02 55 40

					39 01 00 00 00 00 02 FF 25
					39 01 00 00 00 00 02 FB 01
					39 01 00 00 00 00 02 05 04
					39 01 00 00 00 00 02 FF 20
					39 01 00 00 00 00 02 FB 01
					39 01 00 00 00 00 02 62 B0
					39 01 00 00 00 00 02 FF 23
					39 01 00 00 00 00 02 FB 01
					39 01 00 00 00 00 02 08 04
					39 01 00 00 00 00 02 11 01
					39 01 00 00 00 00 02 12 7E
					39 01 00 00 00 00 02 15 6E
					39 01 00 00 00 00 02 16 0B
					39 01 00 00 00 00 02 45 FF
					39 01 00 00 00 00 02 46 F6
					39 01 00 00 00 00 02 47 ED
					39 01 00 00 00 00 02 48 E6
					39 01 00 00 00 00 02 49 DF
					39 01 00 00 00 00 02 4A D8
					39 01 00 00 00 00 02 4B D3
					39 01 00 00 00 00 02 4C CE
					39 01 00 00 00 00 02 4D C9
					39 01 00 00 00 00 02 4E C4
					39 01 00 00 00 00 02 4F C1
					39 01 00 00 00 00 02 50 BE
					39 01 00 00 00 00 02 51 BB
					39 01 00 00 00 00 02 52 B8
					39 01 00 00 00 00 02 53 B6
					39 01 00 00 00 00 02 54 B5
					39 01 00 00 00 00 02 58 FF
					39 01 00 00 00 00 02 59 F6
					39 01 00 00 00 00 02 5A ED
					39 01 00 00 00 00 02 5B E6
					39 01 00 00 00 00 02 5C DF
					39 01 00 00 00 00 02 5D D8
					39 01 00 00 00 00 02 5E D3
					39 01 00 00 00 00 02 5F CE
					39 01 00 00 00 00 02 60 C9
					39 01 00 00 00 00 02 61 C4
					39 01 00 00 00 00 02 62 C1
					39 01 00 00 00 00 02 63 BE
					39 01 00 00 00 00 02 64 BB
					39 01 00 00 00 00 02 65 B8
					39 01 00 00 00 00 02 66 B6
					39 01 00 00 00 00 02 67 B5
					39 01 00 00 00 00 02 FF 10
					39 01 00 00 00 00 02 FB 01
					39 01 00 00 00 00 03 51 00 00
					39 01 00 00 00 00 02 53 24
					39 01 00 00 00 00 02 55 01
					39 01 00 00 00 00 06 3B 03 0E 07 04 04
					29 01 00 00 00 00 02 35 00
					39 01 00 00 05 00 02 FF 23
					39 01 00 00 00 00 02 FB 01
					39 01 00 00 00 00 02 30 FF
					39 01 00 00 00 00 02 31 F0
					39 01 00 00 00 00 02 32 EB
					39 01 00 00 00 00 02 33 E5
					39 01 00 00 00 00 02 34 DD
					39 01 00 00 00 00 02 35 DA
					39 01 00 00 00 00 02 36 D5
					39 01 00 00 00 00 02 37 D0
					39 01 00 00 00 00 02 38 CE
					39 01 00 00 00 00 02 39 CD
					39 01 00 00 00 00 02 3A CD
					39 01 00 00 00 00 02 3B CD
					39 01 00 00 00 00 02 3D CB
					39 01 00 00 00 00 02 3F CB
					39 01 00 00 00 00 02 40 C6
					39 01 00 00 00 00 02 41 BF
					39 01 00 00 00 00 02 45 FF
					39 01 00 00 00 00 02 46 F0
					39 01 00 00 00 00 02 47 E8
					39 01 00 00 00 00 02 48 CE
					39 01 00 00 00 00 02 49 BC
					39 01 00 00 00 00 02 4A B8
					39 01 00 00 00 00 02 4B B5
					39 01 00 00 00 00 02 4C B0
					39 01 00 00 00 00 02 4D A8
					39 01 00 00 00 00 02 4E A0
					39 01 00 00 00 00 02 4F 9B
					39 01 00 00 00 00 02 50 98
					39 01 00 00 00 00 02 51 98
					39 01 00 00 00 00 02 52 88
					39 01 00 00 00 00 02 53 80
					39 01 00 00 00 00 02 54 7F
					39 01 00 00 00 00 02 ff 23
					39 01 00 00 00 00 02 fb 01
					39 01 00 00 00 00 02 00 80
					39 01 00 00 00 00 02 04 05
					39 01 00 00 00 00 02 05 2d
					39 01 00 00 00 00 02 06 01
					39 01 00 00 00 00 02 07 00
					39 01 00 00 00 00 02 08 01
					39 01 00 00 00 00 02 09 00
					39 01 00 00 00 00 02 FF 10
					39 01 00 00 00 00 02 FB 01
					39 01 00 00 00 00 03 68 03 01

					39 01 00 00 64 00 02 11 00
					39 01 00 00 14 00 02 29 00
					];

				qcom,mdss-oled-acl-off-command = [
					39 01 00 00 00 00 02 53 2C
					39 01 00 00 00 00 02 55 00
				];

				qcom,mdss-oled-acl-on-command-level1 = [
					39 01 00 00 00 00 02 53 2C
					39 01 00 00 00 00 02 55 01
				];

				qcom,mdss-oled-acl-on-command-level2 = [
					39 01 00 00 00 00 02 53 2C
					39 01 00 00 00 00 02 55 02
				];

				qcom,mdss-oled-acl-on-command-level3 = [
					39 01 00 00 00 00 02 53 2C
					39 01 00 00 00 00 02 55 03
				];

				qcom,mdss-dsi-off-command = [
					05 01 00 00 32 00 02 28 00
					05 01 00 00 A0 00 02 10 00
					];
				qcom,mdss-dsi-on-command-state = "dsi_lp_mode";
				qcom,mdss-dsi-off-command-state = "dsi_lp_mode";
				qcom,mdss-alpm-command-state = "dsi_hs_mode";
			};
		};
	};
};
