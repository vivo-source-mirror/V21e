/* Copyright (c) 2015-2017, The Linux Foundation. All rights reserved.
 *
 * This program is free software; you can redistribute it and/or modify
 * it under the terms of the GNU General Public License version 2 and
 * only version 2 as published by the Free Software Foundation.
 *
 * This program is distributed in the hope that it will be useful,
 * but WITHOUT ANY WARRANTY; without even the implied warranty of
 * MERCHANTABILITY or FITNESS FOR A PARTICULAR PURPOSE.  See the
 * GNU General Public License for more details.
 */

&mdss_mdp {
	dsi_pd1923_sofeg04_1080_cmd: qcom,mdss_dsi_pd1923_sofeg04_1080p_cmd {
		qcom,mdss-dsi-panel-name = "mdss_dsi_pd1923_sofeg04_1080p_cmd panel";
		qcom,mdss-dsi-panel-type = "dsi_cmd_mode";
		qcom,mdss-dsi-panel-physical-type = "oled";
		qcom,mdss-dsi-virtual-channel-id = <0>;
		qcom,mdss-dsi-stream = <0>;
		qcom,mdss-dsi-bpp = <24>;
		qcom,mdss-dsi-underflow-color = <0xff>;
		qcom,mdss-dsi-border-color = <0>;
		qcom,mdss-dsi-reset-sequence = <1 10>, <0 1>, <1 5>;
		qcom,mdss-dsi-tx-eot-append;
		qcom,mdss-pan-physical-width-dimension = <75>;
		qcom,mdss-pan-physical-height-dimension = <158>;
		qcom,mdss-dsi-traffic-mode = <1>;
		qcom,mdss-dsi-bllp-eof-power-mode;
		qcom,mdss-dsi-bllp-power-mode;
		qcom,mdss-dsi-lane-0-state;
		qcom,mdss-dsi-lane-1-state;
		qcom,mdss-dsi-lane-2-state;
		qcom,mdss-dsi-lane-3-state;
		qcom,mdss-dsi-dma-trigger = "trigger_sw";
		qcom,mdss-dsi-mdp-trigger = "none";
		qcom,mdss-dsi-te-pin-select = <1>;
		qcom,mdss-dsi-wr-mem-start = <0x2c>;
		qcom,mdss-dsi-wr-mem-continue = <0x3c>;
		qcom,mdss-dsi-te-dcs-command = <1>;
		qcom,mdss-dsi-te-check-enable;
		qcom,mdss-dsi-te-using-te-pin;
		qcom,mdss-tear-check-sync-cfg-height = <5000>;
		qcom,mdss-dsi-project-name = "pd1923";
		qcom,mdss-dsi-panel-id = <0x20>;
		qcom,mdss-dsi-bl-level =<255>;
		qcom,mdss-panel-sre;
		qcom,mdss-dsi-panel-hdr-enabled;
		qcom,mdss-dsi-panel-hdr-color-primaries = <14500 15500 32000 17000 15500 30000 8000 3000>;
		qcom,mdss-dsi-panel-peak-brightness = <4200000>;
		qcom,mdss-dsi-panel-blackness-level = <3230>;
		qcom,dsi-dyn-clk-enable;
		qcom,dsi-dyn-clk-list = <1140189120 1130687544>;
		qcom,dc-dimming-support;
		qcom,dc-dimming-pre-wait-te-count = <0>;
		qcom,dc-dimming-wait-te-count = <0>;
		qcom,vivo-dsi-panel-type = "oled";
		qcom,ud-fingerprint-support;
		qcom,mdss-dsi-display-timings {
			timing@0{
		qcom,mdss-dsi-panel-width = <1080>;
		qcom,mdss-dsi-panel-height = <2256>;
		qcom,mdss-dsi-h-front-porch = <123>;
		qcom,mdss-dsi-h-back-porch = <80>;
		qcom,mdss-dsi-h-pulse-width = <16>;
		qcom,mdss-dsi-h-sync-skew = <0>;
		qcom,mdss-dsi-v-back-porch = <72>;
		qcom,mdss-dsi-v-front-porch = <28>;
		qcom,mdss-dsi-v-pulse-width = <4>;
		qcom,mdss-dsi-h-left-border = <0>;
		qcom,mdss-dsi-h-right-border = <0>;
		qcom,mdss-dsi-v-top-border = <0>;
		qcom,mdss-dsi-v-bottom-border = <0>;
		qcom,mdss-dsi-panel-framerate = <62>;
		/* (62-60.5) / 62 = 2.4% */
		qcom,mdss-dsi-panel-jitter = <0x3 0x1>;
		qcom,mdss-dsi-on-command = [
			/* sleep out , wait 20ms */
			05 01 00 00 14 00 01 11
			/* common setting:te on */
			39 00 00 00 00 00 03 9F A5 A5
			39 00 00 00 00 00 02 35 00
			39 01 00 00 00 00 03 9F 5A 5A
			/*	common setting:AVC ON */
			39 01 00 00 00 00 03 F0 5A 5A
			39 01 00 00 00 00 02 B0 07
			39 01 00 00 00 00 02 F4 C0
			39 01 00 00 00 00 03 F0 A5 A5
			/*common setting:TSP SYNC ENABLE*/
			39 01 00 00 00 00 03 F0 5A 5A
			39 01 00 00 00 00 0A B9 00 B0 81 09 00 00 00 11 03
			39 01 00 00 00 00 03 F0 A5 A5
			/*common setting:SOURCE AMP ON*/
			39 01 00 00 00 00 03 FC 5A 5A
			39 01 00 00 00 00 02 B0 17
			39 01 00 00 00 00 02 FD 33
			39 01 00 00 00 00 03 FC A5 A5
			/* Brightness Control*/
			39 01 00 00 64 00 03 F0 5A 5A
			/* dimming frames:0x28,dimming step 2048 dimming*/
			39 00 00 00 00 00 02 B0 05
			39 00 00 00 00 00 02 B0 28
			39 00 00 00 00 00 02 B0 14
			39 00 00 00 00 00 02 B1 C0
			/* 0x13 = elvss dim off,0x53 = elvss dim on*/
			39 00 00 00 00 00 02 B0 02
			39 00 00 00 00 00 02 B7 53
			39 01 00 00 00 00 03 F0 A5 A5
			/* seed CRC*/
			39 00 00 00 00 00 03 F0 5A 5A
			39 00 00 00 00 00 03 F5 11 11
			39 00 00 00 00 00 02 B0 02
			39 00 00 00 00 00 16 F5 B2 0E 04 3A D4 13 0B 03 BF 4A E8 CC C7 14 C8 DE E7 19 FF FD DE
			39 00 00 00 00 00 02 B0 17
			39 00 00 00 00 00 16 F5 FF 03 00 0F FF 00 07 07 FF 18 FF DF FF 0B E4 FB FF 02 FD FF FF
			39 01 00 00 00 00 03 F0 A5 A5
			/* seed TCS*/
			39 00 00 00 00 00 03 F0 5A 5A
			39 00 00 00 00 00 02 B0 4A
			39 00 00 00 00 00 02 F5 80
			39 00 00 00 00 00 02 B0 4B
			39 00 00 00 00 00 02 F5 47
			39 00 00 00 00 00 02 B0 42
			39 00 00 00 00 00 02 F5 11
			39 01 00 00 00 00 03 F0 A5 A5
			/* WRCTRLD */
			39 00 00 00 00 00 02 53 28
			/* set default brightness*/
			39 00 00 00 00 00 03 51 00 00
			/* set acl off,acl dimming */
			39 00 00 00 00 00 02 55 00
			39 00 00 00 00 00 03 F0 5A 5A
			39 00 00 00 00 00 02 B0 0E
			39 00 00 00 00 00 02 B4 28
			39 01 00 00 00 00 03 F0 A5 A5
			/* a block off*/
			39 00 00 00 00 00 03 F0 5A 5A
			39 00 00 00 00 00 02 B0 04
			39 00 00 00 00 00 02 F6 20
			39 01 00 00 00 00 03 F0 A5 A5
			/* Display On*/
			39 01 00 00 00 00 03 9F A5 A5
			05 01 00 00 00 00 01 29
			39 01 00 00 00 00 03 9F 5A 5A
		];
		/*seed ore on*/
		qcom,mdss-oled-seed-ore-on-command =
		[
			39 00 00 00 00 00 03 F0 5A 5A
			39 00 00 00 00 00 02 B0 49
			39 00 00 00 00 00 02 F5 00
			39 00 00 00 00 00 02 B0 42
			39 00 00 00 00 00 02 F5 15
			39 01 00 00 00 00 03 F0 A5 A5
		];
		/*seed ore off*/
		qcom,mdss-oled-seed-ore-off-command =
		[
			39 00 00 00 00 00 03 F0 5A 5A
			39 00 00 00 00 00 02 B0 42
			39 00 00 00 00 00 02 F5 11
			39 01 00 00 00 00 03 F0 A5 A5
		];
		/*adobe srgb*/
		qcom,mdss-oled-seed-crc-on-command-p3 =
		[
			39 00 00 00 00 00 03 F0 5A 5A
			39 00 00 00 00 00 02 B0 01
			39 00 00 00 00 00 02 F5 11
			39 00 00 00 00 00 02 B0 17
			39 00 00 00 00 00 16 F5 FF 03 00 0F FF 00 07 07 FF 18 FF DF FF 0B E4 FB FF 02 FD FF FF
			39 01 00 00 00 00 03 F0 A5 A5
		];
		/*srgb*/
		qcom,mdss-oled-seed-crc-on-command-srgb =
		[
			39 00 00 00 00 00 03 F0 5A 5A
			39 00 00 00 00 00 02 B0 01
			39 00 00 00 00 00 02 F5 10
			39 00 00 00 00 00 02 B0 02
			39 00 00 00 00 00 16 F5 B2 0E 04 3A D4 13 0B 03 BF 4A E8 CC C7 14 C8 DE E7 19 FF FD DE
			39 01 00 00 00 00 03 F0 A5 A5
		];
		/*seed crc off*/
		qcom,mdss-oled-seed-crc-off-command =
		[
			39 00 00 00 00 00 03 F0 5A 5A
			39 00 00 00 00 00 02 B0 01
			39 00 00 00 00 00 02 F5 00
			39 01 00 00 00 00 03 F0 A5 A5
		];

		/*seed crc compenstate default 550~2047*/
		qcom,mdss-oled-seed-crc-compensate-p3-level0 =
		[
			39 00 00 00 00 00 03 F0 5A 5A
			39 00 00 00 00 00 02 B0 1A
			39 00 00 00 00 00 02 F5 0F
			39 00 00 00 00 00 02 B0 1E
			39 00 00 00 00 00 02 F5 07
			39 01 00 00 00 00 03 F0 A5 A5
		];
		/*seed crc compenstate 100nit 250~550*/
		qcom,mdss-oled-seed-crc-compensate-p3-level1 =
		[
			39 00 00 00 00 00 03 F0 5A 5A
			39 00 00 00 00 00 02 B0 1A
			39 00 00 00 00 00 02 F5 0B
			39 00 00 00 00 00 02 B0 1E
			39 00 00 00 00 00 02 F5 05
			39 01 00 00 00 00 03 F0 A5 A5
		];
		/*seed crc compenstate 20nit 50~250*/
		qcom,mdss-oled-seed-crc-compensate-p3-level2 =
		[
			39 00 00 00 00 00 03 F0 5A 5A
			39 00 00 00 00 00 02 B0 18
			39 00 00 00 00 00 02 F5 03
			39 00 00 00 00 00 02 B0 1A
			39 00 00 00 00 00 02 F5 09
			39 00 00 00 00 00 02 B0 1D
			39 00 00 00 00 00 03 F5 07 04
			39 01 00 00 00 00 03 F0 A5 A5
		];
		/*seed crc compenstate 3nit 4~50*/
		qcom,mdss-oled-seed-crc-compensate-p3-level3 =
		[
			39 00 00 00 00 00 03 F0 5A 5A
			39 00 00 00 00 00 02 B0 18
			39 00 00 00 00 00 02 F5 06
			39 00 00 00 00 00 02 B0 1A
			39 00 00 00 00 00 02 F5 05
			39 00 00 00 00 00 02 B0 1D
			39 00 00 00 00 00 03 F5 09 0A
			39 01 00 00 00 00 03 F0 A5 A5
		];

		/*hbm mode 1 520nit*/
		qcom,mdss-oled-hbm-on-command-level1 =
		[
			39 00 00 00 00 00 02 53 E8
			39 00 00 00 00 00 03 F0 5A 5A
			39 00 00 00 00 00 04 B1 10 14 98
			39 00 00 00 00 00 02 F7 03
			39 01 00 00 00 00 03 F0 A5 A5
		];
		/*hbm mode 2 600nit*/
		qcom,mdss-oled-hbm-on-command-level2 =
		[
			39 00 00 00 00 00 02 53 E8
			39 00 00 00 00 00 03 F0 5A 5A
			39 00 00 00 00 00 04 B1 00 14 14
			39 00 00 00 00 00 02 F7 03
			39 01 00 00 00 00 03 F0 A5 A5
		];
		/*fod on sequence
			1.ELVSS DIM OFF & DLY OFF
			2.HBM MODE ON
			3.Wait 1-Frame
			4.PS OFF
			5.image data write
		*/
		qcom,mdss-oled-hbm-on-command-ud-fingerprint =
		[
			/*ELVSS DIM OFF & DLY OFF*/
			39 00 00 00 00 00 03 F0 5A 5A
			39 00 00 00 00 00 02 B0 01
			39 00 00 00 00 00 03 B5 C9 93
			39 01 00 00 00 00 03 F0 A5 A5
			/*HBM MODE ON*/
			39 00 00 00 00 00 02 53 E0
			39 00 00 00 00 00 03 F0 5A 5A
			39 00 00 00 00 00 04 B1 00 14 14
			39 00 00 00 00 00 02 F7 03
			39 01 00 00 00 00 03 F0 A5 A5
		];
		/* elvss dim on*/
		qcom,mdss-oled-elvss-dim-on-command =
		[
			39 00 00 00 00 00 03 F0 5A 5A
			39 00 00 00 00 00 02 B0 02
			39 00 00 00 00 00 02 B5 D3
			39 01 00 00 00 00 03 F0 A5 A5
		];
		/* elvss dim off*/
		qcom,mdss-oled-elvss-dim-off-command =
		[
			39 00 00 00 00 00 03 F0 5A 5A
			39 00 00 00 00 00 02 B0 02
			39 00 00 00 00 00 02 B5 93
			39 01 00 00 00 00 03 F0 A5 A5
		];
		/* ps on*/
		qcom,mdss-oled-ps-on-command =
		[
		/*
			39 00 00 00 00 00 03 F0 5A 5A
			39 00 00 00 00 00 02 B8 C0
			39 01 00 00 00 00 03 F0 A5 A5
		 */
		];
		/*ps off*/
		qcom,mdss-oled-ps-off-command =
		[
		/*
			39 00 00 00 00 00 03 F0 5A 5A
			39 00 00 00 00 00 02 B8 40
			39 01 00 00 00 00 03 F0 A5 A5
		*/
		];
		/*hbm off with smooth*/
		qcom,mdss-oled-hbm-off-command =
		[
			39 01 00 00 00 00 02 53 28
		];
		/*fod out sequence:
			1.HBM MODE OFF
			2.PS ON(ignore)
			3.ELVSS DIM ON & DLY ON
			4.image data write
		*/
		qcom,mdss-oled-hbm-off-command-ud-fingerprint =
		[
			/* HBM MODE OFF */
			39 00 00 00 00 00 02 53 20
			/* PS ON */
			/* ELVSS DIM ON & DLY ON*/
			39 00 00 00 00 00 03 F0 5A 5A
			39 00 00 00 00 00 02 B0 01
			39 00 00 00 00 00 03 B5 C9 53
			39 01 00 00 00 00 03 F0 A5 A5
		];
		/*acl off*/
		qcom,mdss-oled-acl-off-command =
		[
			39 01 00 00 00 00 02 55 00
		];
		/*acl level 1 8%*/
		qcom,mdss-oled-acl-on-command-level1 =
		[
			39 01 00 00 00 00 02 55 01
		];
		/*acl level 2 10%*/
		qcom,mdss-oled-acl-on-command-level2 =
		[
			39 01 00 00 00 00 02 55 02
		];
		/*acl level 3 20%*/
		qcom,mdss-oled-acl-on-command-level3 =
		[
			39 01 00 00 00 00 02 55 03
		];
		/*Dimming Setting*/
		qcom,mdss-oled-dimming-speed =
		[
			39 00 00 00 00 00 03 F0 5A 5A
			39 00 00 00 00 00 02 B0 05
			39 00 00 00 00 00 02 B0 28
			39 00 00 00 00 00 02 B0 02
			39 00 00 00 00 00 02 B7 53
			39 00 00 00 00 00 03 F0 A5 A5
			39 01 00 00 00 00 02 53 28
		];
		/*Dimming set 1 sframe*/
		qcom,mdss-oled-dimming-speed-off =
		[
			39 01 00 00 00 00 02 53 20
		];
		/*AOD MODE:50nit,High Mode,HLPM.*/
		/*
			aod on sequence:
				1.display off
				2.wait 1-frame
				3.image data write
				4.AOD Mode On Setting
				5.wait 1-frame
				6.Display on
		*/
		qcom,mdss-oled-aod-on-command =
		[
			39 01 00 00 00 00 03 9F A5 A5
			39 01 00 00 11 00 02 28 00
			39 01 00 00 00 00 03 9F 5A 5A
			/* aod mode setting*/
			39 00 00 00 00 00 03 F0 5A 5A
				/* aod mode setiing*/
			39 00 00 00 00 00 02 B0 02
			39 00 00 00 00 00 03 BB 08 14
			39 00 00 00 00 00 02 F7 03
			39 00 00 00 00 00 02 B0 01
			39 00 00 00 00 00 03 B5 C1 AF
			39 00 00 00 00 00 02 53 22
			39 00 00 00 00 00 02 BB 01
			39 01 00 00 00 00 03 F0 A5 A5
		];
		qcom,mdss-oled-aod-on-display-on-command =
		[
			39 01 00 00 00 00 03 9F A5 A5
			39 01 00 00 00 00 02 29 00
			39 01 00 00 00 00 03 9F 5A 5A
		];
		/*	ignorl
			qcom,mdss-oled-alpm-hbirghtness-on-command =
			[
				39 00 00 00 00 00 03 F0 5A 5A
				39 00 00 00 00 00 02 B0 69
				39 00 00 00 00 00 06 B9 08 08 D0 08 0E
				39 00 00 00 00 00 02 B0 70
				39 00 00 00 00 00 02 B9 D7
				39 00 00 00 00 00 02 B0 0B
				39 00 00 00 00 00 02 F4 6C
				39 00 00 00 00 00 02 53 22
				39 00 00 00 00 00 02 B0 A5
				39 00 00 00 00 00 02 C7 01
				39 01 00 00 00 00 03 F0 A5 A5
			];
			qcom,mdss-oled-alpm-lbirghtness-on-command =
			[
				39 01 00 00 00 00 03 F0 5A 5A
				39 01 00 00 00 00 02 B0 69
				39 01 00 00 00 00 06 B9 08 08 D0 08 0E
				39 01 00 00 00 00 02 B0 70
				39 01 00 00 00 00 02 B9 D7
				39 01 00 00 00 00 02 B0 0B
				39 01 00 00 00 00 02 F4 6C
				39 01 00 00 00 00 02 53 23
				39 01 00 00 00 00 02 B0 A5
				39 01 00 00 00 00 02 C7 01
				39 01 00 00 00 00 03 F0 A5 A5
			];
			qcom,mdss-oled-hlpm-hbirghtness-on-command =
			[
				39 01 00 00 00 00 03 F0 5A 5A
				39 01 00 00 00 00 02 B0 69
				39 01 00 00 00 00 06 B9 08 08 D0 08 0E
				39 01 00 00 00 00 02 B0 70
				39 01 00 00 00 00 02 B9 D7
				39 01 00 00 00 00 02 B0 0B
				39 01 00 00 00 00 02 F4 6C
				39 01 00 00 00 00 02 53 22
				39 01 00 00 00 00 02 B0 A5
				39 01 00 00 00 00 02 C7 00
				39 01 00 00 00 00 03 F0 A5 A5
			];
			qcom,mdss-oled-hlpm-lbirghtness-on-command =
			[
				39 01 00 00 00 00 03 F0 5A 5A
				39 01 00 00 00 00 02 B0 69
				39 01 00 00 00 00 06 B9 08 08 D0 08 0E
				39 01 00 00 00 00 02 B0 70
				39 01 00 00 00 00 02 B9 D7
				39 01 00 00 00 00 02 B0 0B
				39 01 00 00 00 00 02 F4 6C
				39 01 00 00 00 00 02 53 23
				39 01 00 00 00 00 02 B0 A5
				39 01 00 00 00 00 02 C7 00
				39 01 00 00 00 00 03 F0 A5 A5
			];
		*/
		/* aod off */
		qcom,mdss-oled-aod-off-command =
		[

			39 00 00 00 00 00 03 F0 5A 5A
			39 00 00 00 00 00 02 BB 01
			39 00 00 00 00 00 02 B0 01
			39 00 00 00 00 00 03 B5 C9 D3
			39 00 00 00 00 00 02 53 28
			39 01 00 00 00 00 03 F0 A5 A5
			39 00 00 00 00 00 02 53 20
			39 00 00 00 00 00 03 9F A5 A5
			39 00 00 00 00 00 02 13 00
			39 00 00 00 00 00 02 29 00
			39 01 00 00 00 00 03 9F 5A 5A
		];
		/*set display on*/
		qcom,mdss-oled-display-on-command =
		[
			39 00 00 00 00 00 02 53 20
			39 00 00 00 00 00 03 9F A5 A5
			39 00 00 00 00 00 02 13 00
			39 00 00 00 00 00 02 29 00
			39 01 00 00 00 00 03 9F 5A 5A
		];
		/*off*/
		qcom,mdss-dsi-off-command = [
			/* display off,wait 1frame*/
			39 00 00 00 00 00 03 9F A5 A5
			39 00 00 00 00 00 02 28 00
			39 01 00 00 11 00 03 F0 5A 5A
			/* sleep in,wait above 120ms*/
			39 00 00 00 00 00 03 9F A5 A5
			39 00 00 00 00 00 02 10 00
			39 01 00 00 78 00 03 F0 5A 5A
		];
		qcom,mdss-dsi-on-command-state = "dsi_lp_mode";
		qcom,mdss-dsi-off-command-state = "dsi_lp_mode";
		qcom,mdss-dsi-h-sync-pulse = <0>;
		qcom,mdss-default-command-state = "dsi_hs_mode";
		qcom,mdss-oled-seed-crc-compensate-command-state = "dsi_hs_mode";
			};
		};
	};
};
