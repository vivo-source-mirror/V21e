/* Copyright (c) 2018, The Linux Foundation. All rights reserved.
 *
 * This program is free software; you can redistribute it and/or modify
 * it under the terms of the GNU General Public License version 2 and
 * only version 2 as published by the Free Software Foundation.
 *
 * This program is distributed in the hope that it will be useful,
 * but WITHOUT ANY WARRANTY; without even the implied warranty of
 * MERCHANTABILITY or FITNESS FOR A PARTICULAR PURPOSE.  See the
 * GNU General Public License for more details.
 */

&mdss_mdp {
	dsi_pd1838_1080_cmd: qcom,pd1838_mdss_dsi_sofego1_1080p_cmd {
		qcom,mdss-dsi-panel-name = "pd1838 sofego1 1080p cmd mode dsi panel";
		qcom,mdss-dsi-panel-type = "dsi_cmd_mode";
		qcom,mdss-dsi-virtual-channel-id = <0>;
		qcom,mdss-dsi-stream = <0>;
		qcom,mdss-dsi-bpp = <24>;
		qcom,mdss-dsi-underflow-color = <0xff>;
		qcom,mdss-dsi-border-color = <0>;
		qcom,mdss-dsi-reset-sequence = <1 10>, <0 10>, <1 10>;
		qcom,mdss-pan-physical-width-dimension = <68>;
		qcom,mdss-pan-physical-height-dimension = <148>;
		qcom,mdss-dsi-traffic-mode = "non_burst_sync_event";
		qcom,mdss-dsi-lane-map = "lane_map_0123";
		qcom,mdss-dsi-bllp-eof-power-mode;
		qcom,mdss-dsi-bllp-power-mode;
		qcom,mdss-dsi-lane-0-state;
		qcom,mdss-dsi-lane-1-state;
		qcom,mdss-dsi-lane-2-state;
		qcom,mdss-dsi-lane-3-state;
		qcom,mdss-dsi-dma-trigger = "trigger_sw";
		qcom,mdss-dsi-mdp-trigger = "none";
		qcom,mdss-dsi-te-pin-select = <1>;
		qcom,mdss-dsi-wr-mem-start = <0x2c>;
		qcom,mdss-dsi-wr-mem-continue = <0x3c>;
		qcom,mdss-dsi-te-dcs-command = <1>;
		qcom,mdss-dsi-te-check-enable;
		qcom,mdss-dsi-te-using-te-pin;
		qcom,mdss-dsi-panel-id = <0x20>;
		qcom,mdss-dsi-project-name = "pd1832";
		qcom,mdss-panel-sre;
		qcom,dynamic-dsi-timing-enable;
		qcom,mdss-dsi-panel-clockrate = <1178400000>;
		qcom,mdss-dsi-panel-intent-clockrate = <1170000000>;
		qcom,vivo-dsi-panel-type = "oled";
		qcom,mdss-dsi-panel-physical-type = "oled";
		qcom,ud-fingerprint-support;
		qcom,dc-dimming-support;
		qcom,dc-dimming-wait-te-count = <1>;
		qcom,dc-dimming-pre-wait-te-count = <1>;

		qcom,mdss-dsi-display-timings {
			timing@0{
				qcom,mdss-dsi-panel-width = <1080>;
				qcom,mdss-dsi-panel-height = <2340>;
				qcom,mdss-dsi-h-front-porch = <96>;
				qcom,mdss-dsi-h-back-porch = <124>;
				qcom,mdss-dsi-h-pulse-width = <16>;
				qcom,mdss-dsi-h-sync-skew = <0>;
				qcom,mdss-dsi-v-back-porch = <84>;
				qcom,mdss-dsi-v-front-porch = <60>;
				qcom,mdss-dsi-v-pulse-width = <4>;
				qcom,mdss-dsi-h-left-border = <0>;
				qcom,mdss-dsi-h-right-border = <0>;
				qcom,mdss-dsi-v-top-border = <0>;
				qcom,mdss-dsi-v-bottom-border = <0>;
				qcom,mdss-dsi-panel-framerate = <60>;
				qcom,dynamic-dsi-timing-enable;
				qcom,mdss-dsi-panel-clockrate = <1178400000>;
				qcom,mdss-dsi-on-command = [
					/* Sleep Out */
					39 01 00 00 00 00 03 9F A5 A5
					39 01 00 00 37 00 02 11 00
					39 01 00 00 00 00 03 9F 5A 5A
					/* Decrease AOR */
					39 00 00 00 00 00 03 F0 5A 5A
					39 00 00 00 00 00 02 B0 50
					39 00 00 00 00 00 02 B9 89
					39 00 00 00 00 00 03 F0 A5 A5
					/* Common Setting */
					39 01 00 00 00 00 03 9F A5 A5
					39 01 00 00 00 00 02 35 00
					39 01 00 00 00 00 03 9F 5A 5A
					/* ESD S/W work around*/
					39 01 00 00 00 00 03 F1 5A 5A
					39 01 00 00 00 00 03 FC 5A 5A
					39 01 00 00 00 00 02 B0 01
					39 01 00 00 00 00 02 E3 C8
					39 01 00 00 00 00 02 B0 07
					39 01 00 00 00 00 02 ED 67
					39 01 00 00 00 00 02 D0 08
					39 01 00 00 00 00 03 F1 A5 A5
					39 01 00 00 00 00 03 FC A5 A5
					/* Brightness Setting */
					39 01 00 00 00 00 03 F0 5A 5A
					39 01 00 00 00 00 02 B0 07
					39 01 00 00 00 00 02 B7 01
					39 01 00 00 00 00 03 F0 A5 A5
					39 01 00 00 41 00 02 53 20
					39 01 00 00 00 00 02 55 00
					/* Display On */
					39 01 00 00 00 00 03 9F A5 A5
					39 01 00 00 11 00 02 29 00
					39 01 00 00 00 00 03 9F 5A 5A
					39 01 00 00 00 00 03 F0 5A 5A
					/* ACL dimming setting */
					39 01 00 00 00 00 02 B0 DE
					39 01 00 00 00 00 02 B9 48
					/* Normal AOR */
					39 00 00 00 00 00 02 B0 50
					39 00 00 00 00 00 02 B9 9B
					/* seed setting*/
					39 01 00 00 00 00 02 81 90
					39 01 00 00 00 00 18 B1 00 00 FF 02 00 18 FF 01 03 0C FF 1A FF E3 FF 0F F1 FF F8 01 FD FF FE
					/* up/down area Magenta/Greenish */
					39 01 00 00 00 00 03 B6 00 02

					/* TCS Target Color Skin setting */
					39 01 00 00 00 00 02 B0 1C
					39 01 00 00 00 00 02 B3 00
					39 01 00 00 00 00 02 B0 23
					39 01 00 00 00 00 02 B3 91
					39 01 00 00 00 00 02 B0 21
					39 01 00 00 00 00 02 B3 F8
					39 01 00 00 00 00 02 83 80
					39 01 00 00 00 00 03 B3 00 C0

					39 01 00 00 00 00 03 F0 A5 A5
				];

				/* samsung OLED ORE mode */
				qcom,mdss-oled-seed-ore-on-command =
				[
					39 00 00 00 00 00 03 F0 5A 5A
					39 00 00 00 00 00 03 87 80 00
					39 00 00 00 00 00 02 B0 52
					39 00 00 00 00 00 02 B3 00
					39 01 00 00 00 00 03 F0 A5 A5
				];

				qcom,mdss-oled-seed-ore-off-command =
				[
					39 00 00 00 00 00 03 F0 5A 5A
					39 00 00 00 00 00 02 B0 52
					39 00 00 00 00 00 02 B3 01
					39 01 00 00 00 00 03 F0 A5 A5
				];

				/* samsung OLED CRC mode */
				qcom,mdss-oled-seed-crc-on-command-p3 =
				[
					39 01 00 00 00 00 03 F0 5A 5A
					39 01 00 00 00 00 02 81 90
					39 01 00 00 00 00 18 B1 00 00 FF 03 00 18 FF 01 03 0D FF 1D FF E4 FF 0F F1 FF F8 01 FF FF FF
					39 01 00 00 00 00 03 F0 A5 A5
				];

				/* samsung OLED HBM mode */
				qcom,mdss-oled-seed-crc-on-command-srgb =
				[
					39 01 00 00 00 00 03 F0 5A 5A
					39 01 00 00 00 00 02 81 90
					39 01 00 00 00 00 18 B1 00 00 B7 0D 05 3F CE 14 04 07 A9 50 E8 D1 C7 14 C8 E6 E2 1F FF FD DE
					39 01 00 00 00 00 03 F0 A5 A5
				];

				qcom,mdss-oled-seed-crc-off-command =
				[
					39 01 00 00 00 00 03 F0 5A 5A
					39 01 00 00 00 00 02 81 00
					39 01 00 00 00 00 03 B1 00 01
					39 01 00 00 00 00 03 F0 A5 A5
				];

				/* samsung OLED HBM mode */
				qcom,mdss-oled-hbm-on-command-level1 =
				[
					39 01 00 00 00 00 03 F0 5A 5A
					39 01 00 00 00 00 02 B0 07
					39 01 00 00 00 00 02 B7 28
					39 01 00 00 00 00 03 F0 A5 A5
					39 01 00 00 11 00 02 53 28
					39 01 00 00 00 00 02 53 E8
					39 01 00 00 00 00 03 51 00 D8
				];

				qcom,mdss-oled-hbm-on-command-level2 =
				[
					39 01 00 00 00 00 03 F0 5A 5A
					39 01 00 00 00 00 02 B0 07
					39 01 00 00 00 00 02 B7 28
					39 01 00 00 00 00 03 F0 A5 A5
					39 01 00 00 11 00 02 53 28
					39 01 00 00 00 00 02 53 E8
					39 01 00 00 00 00 03 51 03 FF
				];

				qcom,mdss-oled-hbm-on-command-ud-fingerprint =
				[
					39 00 00 00 00 00 03 F0 5A 5A
					39 00 00 00 00 00 04 B7 00 01 5B
					39 00 00 00 00 00 03 F0 A5 A5
					39 00 00 00 00 00 02 53 E0
					39 01 00 00 00 00 03 51 03 FF
				];

				qcom,mdss-oled-ps-off-command =
				[
					39 00 00 00 00 00 03 F0 5A 5A
					39 00 00 00 00 00 03 BD 00 00
					39 00 00 00 00 00 04 B7 00 01 53
					39 01 00 00 00 00 03 F0 A5 A5
				];

				qcom,mdss-oled-ps-on-command =
				[
					39 00 00 00 00 00 03 F0 5A 5A
					39 00 00 00 00 00 03 BD 00 02
					39 00 00 00 00 00 03 F0 A5 A5
				];

				qcom,mdss-oled-dly-on-command =
				[
					39 00 00 00 00 00 03 F0 5A 5A
					39 00 00 00 00 00 04 B7 00 01 53
					39 01 00 00 00 00 03 F0 A5 A5
				];

				qcom,mdss-oled-dly-off-command =
				[
					39 00 00 00 00 00 03 F0 5A 5A
					39 00 00 00 00 00 04 B7 00 01 5B
					39 01 00 00 00 00 03 F0 A5 A5
				];

				qcom,mdss-oled-hbm-off-command =
				[
					39 01 00 00 00 00 02 53 28
				];

				qcom,mdss-oled-hbm-off-command-ud-fingerprint =
				[
					39 00 00 00 00 00 03 F0 5A 5A
					39 00 00 00 00 00 03 BD 00 02
					39 00 00 00 00 00 03 F0 A5 A5
					39 01 00 00 00 00 02 53 20
				];

				qcom,mdss-oled-acl-on-command-level1 =
				[
					39 01 00 00 00 00 02 55 01
				];

				qcom,mdss-oled-acl-on-command-level2 =
				[
					39 01 00 00 00 00 02 55 02
				];

				qcom,mdss-oled-acl-on-command-level3 =
				[
					39 01 00 00 00 00 02 55 03
				];

				qcom,mdss-oled-acl-off-command =
				[
					39 01 00 00 00 00 02 55 00
				];

				qcom,mdss-oled-dimming-speed =
				[
					39 01 00 00 00 00 03 F0 5A 5A
					39 01 00 00 00 00 02 B0 07
					39 01 00 00 00 00 02 B7 28
					39 01 00 00 00 00 03 F0 A5 A5
					39 01 00 00 00 00 02 53 28
				];

				qcom,mdss-oled-dimming-speed-off =
				[
					39 01 00 00 00 00 02 53 20
				];

				/* samsung OLED AOD mode, defaut mode  HLPM high brightness */
				qcom,mdss-oled-aod-on-command =
				[
					/* Decrease AOR */
					39 00 00 00 00 00 03 F0 5A 5A
					39 00 00 00 00 00 02 B0 50
					39 00 00 00 00 00 02 B9 89
					39 00 00 00 11 00 03 F0 A5 A5

					39 01 00 00 00 00 03 9F A5 A5
					39 01 00 00 11 00 02 28 00
					39 01 00 00 00 00 03 9F 5A 5A

					39 01 00 00 00 00 03 F0 5A 5A
					39 01 00 00 00 00 02 B0 DF
					39 01 00 00 00 00 05 B8 02 C1 00 5D
					39 01 00 00 00 00 03 F0 A5 A5

					39 01 00 00 00 00 03 9F A5 A5
					39 01 00 00 00 00 02 13 00
					39 01 00 00 00 00 03 9F 5A 5A
				];

				qcom,mdss-oled-alpm-hbirghtness-on-command =
				[
					39 01 00 00 00 00 03 F0 5A 5A
					39 01 00 00 00 00 02 B0 DF
					39 01 00 00 00 00 05 B8 02 C1 00 5D
					39 01 00 00 00 00 02 B0 69
					39 01 00 00 00 00 06 B9 08 08 D0 08 0E
					39 01 00 00 00 00 02 B0 0B
					39 01 00 00 00 00 02 F4 6C
					39 01 00 00 00 00 02 53 22
					39 01 00 00 00 00 02 B0 A5
					39 01 00 00 00 00 02 C7 01
					39 01 00 00 00 00 03 F0 A5 A5

					39 01 00 00 00 00 03 9F A5 A5
					39 01 00 00 00 00 02 29 00
					39 01 00 00 00 00 03 9F 5A 5A
				];

				qcom,mdss-oled-alpm-lbirghtness-on-command =
				[
					39 01 00 00 00 00 03 F0 5A 5A
					39 01 00 00 00 00 02 B0 DF
					39 01 00 00 00 00 05 B8 02 C1 00 5D
					39 01 00 00 00 00 02 B0 69
					39 01 00 00 00 00 06 B9 08 08 D0 08 0E
					39 01 00 00 00 00 02 B0 0B
					39 01 00 00 00 00 02 F4 6C
					39 01 00 00 00 00 02 53 23
					39 01 00 00 00 00 02 B0 A5
					39 01 00 00 00 00 02 C7 01
					39 01 00 00 00 00 03 F0 A5 A5

					39 01 00 00 00 00 03 9F A5 A5
					39 01 00 00 00 00 02 29 00
					39 01 00 00 00 00 03 9F 5A 5A
				];

				qcom,mdss-oled-hlpm-hbirghtness-on-command =
				[
					39 01 00 00 00 00 03 F0 5A 5A
					39 01 00 00 00 00 02 B0 DF
					39 01 00 00 00 00 05 B8 02 C1 00 5D
					39 01 00 00 00 00 02 B0 69
					39 01 00 00 00 00 06 B9 08 08 D0 08 0E
					39 01 00 00 00 00 02 B0 0B
					39 01 00 00 00 00 02 F4 6C
					39 01 00 00 00 00 02 53 22
					39 01 00 00 00 00 02 B0 A5
					39 01 00 00 00 00 02 C7 00
					39 01 00 00 00 00 03 F0 A5 A5

					39 01 00 00 00 00 03 9F A5 A5
					39 01 00 00 00 00 02 29 00
					39 01 00 00 00 00 03 9F 5A 5A
				];

				qcom,mdss-oled-hlpm-lbirghtness-on-command =
				[
					39 01 00 00 00 00 03 F0 5A 5A
					39 01 00 00 00 00 02 B0 DF
					39 01 00 00 00 00 05 B8 02 C1 00 5D
					39 01 00 00 00 00 02 B0 69
					39 01 00 00 00 00 06 B9 08 08 D0 08 0E
					39 01 00 00 00 00 02 B0 0B
					39 01 00 00 00 00 02 F4 6C
					39 01 00 00 00 00 02 53 23
					39 01 00 00 00 00 02 B0 A5
					39 01 00 00 00 00 02 C7 00
					39 01 00 00 00 00 03 F0 A5 A5

					39 01 00 00 00 00 03 9F A5 A5
					39 01 00 00 00 00 02 29 00
					39 01 00 00 00 00 03 9F 5A 5A
				];

				qcom,mdss-oled-aod-off-command =
				[
					39 01 00 00 00 00 03 9F A5 A5
					39 01 00 00 11 00 02 22 00
					39 01 00 00 11 00 02 28 00
					39 01 00 00 00 00 03 9F 5A 5A
					39 01 00 00 00 00 02 53 28
				];

				qcom,mdss-oled-aod-off-command-bsp-test =
				[
					39 01 00 00 00 00 03 9F A5 A5
					39 01 00 00 11 00 02 22 00
					39 01 00 00 11 00 02 28 00
					39 01 00 00 00 00 03 9F 5A 5A
					39 01 00 00 00 00 02 53 28
					39 01 00 00 00 00 03 9F A5 A5
					39 01 00 00 00 00 02 13 00
					39 01 00 00 00 00 02 29 00
					39 01 00 00 00 00 03 9F 5A 5A
				];

				qcom,mdss-oled-display-on-command =
				[
					/* Normal AOR */
					39 00 00 00 00 00 03 F0 5A 5A
					39 00 00 00 00 00 02 B0 50
					39 00 00 00 11 00 02 B9 9B
					39 00 00 00 00 00 03 F0 A5 A5
					39 01 00 00 00 00 02 53 20
					39 01 00 00 00 00 03 9F A5 A5
					39 01 00 00 00 00 02 13 00
					39 01 00 00 00 00 02 29 00
					39 01 00 00 00 00 03 9F 5A 5A
				];

				qcom,mdss-alpm-command-state = "dsi_lp_mode";
				qcom,mdss-dsi-off-command = [
					/* Decrease AOR */
					39 00 00 00 00 00 03 F0 5A 5A
					39 00 00 00 00 00 02 B0 50
					39 00 00 00 11 00 02 B9 89
					39 00 00 00 00 00 03 F0 A5 A5

					39 01 00 00 00 00 03 9F A5 A5
					39 01 00 00 11 00 02 28 00
					39 01 00 00 00 00 02 10 00
					39 01 00 00 00 00 03 9F 5A 5A
					39 01 00 00 00 00 03 F0 5A 5A
					39 01 00 00 00 00 02 B0 05
					39 01 00 00 00 00 02 F4 01
					39 01 00 00 97 00 03 F0 A5 A5
				];

				qcom,mdss-oled-aor-test-on-command =
				[
					39 01 00 00 00 00 03 F0 5A 5A
					39 01 00 00 00 00 03 51 03 FF
					39 01 00 00 00 00 02 B0 60
					39 01 00 00 00 00 03 B9 09 30
					39 01 00 00 00 00 03 C0 00 31
					39 01 00 00 00 00 02 B0 27
					39 01 00 00 00 00 05 C0 20 0B 44 48
					39 01 00 00 00 00 02 B0 2F
					39 01 00 00 00 00 02 C0 3C
					39 01 00 00 00 00 03 C0 00 31
					39 01 00 00 00 00 02 B0 0F
					39 01 00 00 00 00 02 F4 00
					39 01 00 00 00 00 03 F0 A5 A5
				];

				qcom,mdss-oled-aor-test-off-command =
				[
					39 01 00 00 00 00 03 F0 5A 5A
					39 01 00 00 00 00 03 51 03 FF
					39 01 00 00 00 00 02 B0 0F
					39 01 00 00 00 00 02 F4 13
					39 01 00 00 00 00 02 B0 27
					39 01 00 00 00 00 05 C0 E0 0B 73 78
					39 01 00 00 00 00 02 B0 2F
					39 01 00 00 00 00 02 C0 FC
					39 01 00 00 00 00 03 C0 00 31
					39 01 00 00 00 00 02 B0 60
					39 01 00 00 00 00 03 B9 00 10
					39 01 00 00 00 00 03 C0 00 31
					39 01 00 00 00 00 03 F0 A5 A5
				];

				qcom,mdss-dsi-on-command-state = "dsi_lp_mode";
				qcom,mdss-dsi-off-command-state = "dsi_lp_mode";
				qcom,mdss-dsi-h-sync-pulse = <0>;
			};
		};
	};
};
